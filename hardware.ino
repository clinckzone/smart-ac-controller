#include <Adafruit_Sensor.h>
#include <DHT.h>
#include <DHT_U.h>

#define DHTPIN_OUT 2
#define DHTPIN_IN 3
#define DHTTYPE DHT22

//Temperature and humidity
DHT dhtOut(DHTPIN_OUT, DHTTYPE);
DHT dhtIn(DHTPIN_IN, DHTTYPE);

float humOut;
float tempOut;
float humIn;
float tempIn;

int currTemp = 26; //Stores the current temperature to which A.C. has been set.
int ctrTemp;

//Remote control
int IRpin = 5 ;
unsigned int  on[213] = {100,1150, 3250,3350, 400,1200, 500,300, 500,1150, 500,1150, 450,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450, 400};  // UNKNOWN 3BE75A41
unsigned int  off[211] = {3250,3300, 500,1150, 500,300, 500,1150, 500,1150, 450,350, 500,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350, 400};  // UNKNOWN AE4284BE
unsigned int  temp16[211] = {3350,3200, 500,1150, 500,350, 450,1200, 350,1250, 500,300, 500,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350, 500};  // UNKNOWN EB578117
unsigned int  temp17[211] = {3250,3300, 450,1150, 500,350, 450,1200, 450,1150, 450,400, 450,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400, 400};  // UNKNOWN 3B7C226A
unsigned int  temp18[211] = {3250,3300, 500,1150, 400,450, 350,1250, 500,1150, 450,350, 500,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350, 500};  // UNKNOWN AC5745C8
unsigned int  temp19[211] = {3300,3250, 450,1150, 500,350, 500,1100, 500,1150, 500,350, 450,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400, 400};  // UNKNOWN A19FF449
unsigned int  temp20[211] = {3300,3250, 450,1150, 500,350, 500,1150, 450,1150, 500,350, 450,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450, 450};  // UNKNOWN 351BA520
unsigned int  temp21[211] = {3200,3350, 400,1200, 450,400, 400,1250, 400,1200, 450,400, 450,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400, 450};  // UNKNOWN A40E46F8
unsigned int  temp22[211] = {3200,3350, 450,1150, 450,400, 450,1200, 450,1150, 400,450, 400,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450, 400};  // UNKNOWN 24E90981
unsigned int  temp23[211] = {3250,3300, 450,1150, 450,400, 450,1150, 500,1150, 450,350, 450,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450, 450};  // UNKNOWN 21DC1F6C
unsigned int  temp24[211] = {3300,3300, 400,1200, 500,350, 450,1200, 450,1150, 450,400, 450,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350, 450};  // UNKNOWN F058FAC0
unsigned int  temp25[211] = {3300,3300, 350,1250, 500,300, 500,1150, 500,1150, 450,350, 500,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400, 450};  // UNKNOWN A77D3A1E
unsigned int  temp26[211] = {3300,3250, 450,1200, 400,400, 400,1250, 450,1150, 400,450, 400,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450, 450};  // UNKNOWN 3A220BF1

void setup() {
  Serial.begin(9600);
  pinMode(IRpin, OUTPUT); 
  dhtOut.begin();
  dhtIn.begin();  
}

void loop() {  
  detectTempHum();
  delay(1000);
  sendTempHum();
  delay(15000);
  ctrTemp = receiveCtrTemp();
  delay(100);
  setCtrTemp(ctrTemp);
  delay(100);
}   

void detectTempHum()  {
  humOut = dhtOut.readHumidity();
  tempOut = dhtOut.readTemperature();

  humIn = dhtIn.readHumidity();
  tempIn = dhtIn.readTemperature();
}

void sendTempHum()  {
  Serial.print(humOut);
  Serial.print(",");
  Serial.print(tempOut);
  Serial.print(",");
  Serial.print(humIn);
  Serial.print(",");
  Serial.print(tempIn);
}

byte receiveCtrTemp() {
  int _ctrTemp;
  if(Serial.available() > 0) {
    //read value and store it in currTemp
    _ctrTemp = Serial.read();
    currTemp = _ctrTemp;
  }
  else {
    _ctrTemp = currTemp;
  }
  return _ctrTemp;
}

void setCtrTemp(int _ctrTemp) {
  if(_ctrTemp == 16)  {
    SendChannelUpCode(temp16, sizeof(temp16)/sizeof(temp16[0]));
  }
  else if(_ctrTemp == 17) {
    SendChannelUpCode(temp17, sizeof(temp17)/sizeof(temp17[0]));
  }
  else if(_ctrTemp == 18) {
    SendChannelUpCode(temp18, sizeof(temp18)/sizeof(temp18[0]));
  }
  else if(_ctrTemp == 19) {
    SendChannelUpCode(temp19, sizeof(temp19)/sizeof(temp19[0]));
  }
  else if(_ctrTemp == 20) {
    SendChannelUpCode(temp20, sizeof(temp20)/sizeof(temp20[0]));
  }
  else if(_ctrTemp == 21) {
    SendChannelUpCode(temp21, sizeof(temp21)/sizeof(temp21[0]));
  }
  else if(_ctrTemp == 22) {
    SendChannelUpCode(temp22, sizeof(temp22)/sizeof(temp22[0]));
  }
  else if(_ctrTemp == 23) {
    SendChannelUpCode(temp23, sizeof(temp23)/sizeof(temp23[0]));
  }
  else if(_ctrTemp == 24) {
    SendChannelUpCode(temp24, sizeof(temp24)/sizeof(temp24[0]));
  }
  else if(_ctrTemp == 25) {
    SendChannelUpCode(temp25, sizeof(temp25)/sizeof(temp25[0]));
  }
  else if(_ctrTemp == 26) {
    SendChannelUpCode(temp26, sizeof(temp26)/sizeof(temp26[0]));
  }
}

//manual generation of pulses
void pulseIR(long microsec)  {
  cli();
  while(microsec > 0) {
    digitalWrite(IRpin, HIGH);
    delayMicroseconds(10);
    digitalWrite(IRpin, LOW);
    delayMicroseconds(10);
    microsec -= 26;
  }
  sei();
}
 
void SendChannelUpCode(int IRsignal[], int size)  {
  for(int i = 0; i < size; i += 2) {
    delayMicroseconds(IRsignal[i]);
    pulseIR(IRsignal[i+1]);
  }
}
